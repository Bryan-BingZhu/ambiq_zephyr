## Kconfig.am
```kconfig
#
# Copyright (c) 2023 Ambiq Micro, Inc.
# All rights reserved.
#

# Usually BOARD_DIR is an absolute path and sourced through '<ZEPHYR_ROOT>/boards/Kconfig'.
# But for compliance and doc generation it's a glob and this line ensures that
# boards in this sdk are sourced properly in those occasions.
orsource "./$(BOARD_DIR)/Kconfig.board"
orsource "./$(BOARD_DIR)/Kconfig"

menu "Ambiq Zephyr"

# Ambiq SDK default experimental warnings to on.
config WARN_EXPERIMENTAL
	default y

rsource "samples/Kconfig"
rsource "drivers/Kconfig"

endmenu
```

## drivers/ambt53/Kconfig
```kconfig
# Copyright (c) 2023 Ambiq Micro, Inc.
# All rights reserved.


menuconfig AMBT53_XIP_DRIVER
    bool "AMBT53 driver"
    default n
    depends on DT_HAS_CUSTOM_AMBT53_ENABLED
    help
      Enable custom driver for AMBT53

config CUSTOM_AMBT53_INIT_PRIORITY
	int "Init priority"
	default 71
	help
	  Device driver initialization priority.
```

## samples/Kconfig
```kconfig
#
# Copyright (c) 2023 Ambiq Micro, Inc.
# All rights reserved.
#

config AM_SAMPLES_DEFAULTS
	bool "Enable Ambiq sample default settings"
	default n
	imply LOG
	imply LOG_DEFAULT_MINIMAL
	imply ASSERT
	imply ASSERT_NO_COND_INFO
	imply ASSERT_NO_MSG_INFO
	imply HW_STACK_PROTECTION if ARCH_HAS_STACK_PROTECTION
	help
	  Use the default configuration for Ambiq samples.
```

## samples/out_of_tree_driver/custom_drivers/zephyr/ambt53/Kconfig
```kconfig
# Copyright (c) 2019 Nordic Semiconductor
# SPDX-License-Identifier: Apache-2.0

config AMBT53_XIP_DRIVER
	bool "Support for the demonstration out of tree driver"
```

## west.yml
```yaml
# The west manifest file for the nRF Connect SDK (NCS).
#
# The per-installation west configuration file specifies the location of this
# manifest file. The "path" option in the [manifest] section of .west/config
# defines the folder that contains west.yml. The path is relative to the folder
# that contains .west.
#
# You can create your own manifest files and put them in any
# repository you want, to create your own custom NCS installation.
# For example, you could create a manifest file in your own
# out-of-tree application directory, which would pull the nrf repository
# in as an ordinary project.
#
# You can pass your manifest repositories to west init when creating a
# new NCS installation. See the west documentation for more
# information.
manifest:
  version: "0.13"
  
  remotes:
      # nRF Connect SDK base URL.
    - name: my_zephyr
      url-base: https://github.com/Bryan-BingZhu/ambiq_zephyr.git
    # Third-party repository sources:
    - name: zephyrproject
      url-base: https://github.com/zephyrproject-rtos

  defaults:
    remote: my_zephyr
    
  group-filter: [-zephyrproject]
  # "projects" is a list of git repositories which make up the NCS
  # source code.
  #
  # For 'userdata' fields in the projects area, please refer to:
  # https://developer.nordicsemi.com/nRF_Connect_SDK/doc/latest/nrf/dm_code_base.html
  projects:

    # The Zephyr RTOS fork in the NCS, along with the subset of its
    # modules which NCS imports directly.
    #
    # https://developer.nordicsemi.com/nRF_Connect_SDK/doc/latest/zephyr/introduction/index.html
    # https://developer.nordicsemi.com/nRF_Connect_SDK/doc/latest/zephyr/guides/modules.html
    - name: zephyr
      remote: zephyrproject
      repo-path: zephyr
      path: zephyr
      revision: main
      import:
        # In addition to the zephyr repository itself, NCS also
        # imports the contents of zephyr/west.yml at the above
        # revision. Only the projects explicitly named in the
        # following allowlist are imported.
        #
        # Note that the zephyr west extensions (like 'build', 'flash',
        # 'debug', etc.) are automatically provided by this import, so
        # there's no need to add a redundant west-commands: key for
        # the zephyr project.
        #
        # Please keep this list sorted alphabetically.
        name-allowlist:
          - TraceRecorderSource
          - canopennode
          - chre
          - cmsis
          - edtt
          - fatfs
          - hal_ambiq
          - hal_nordic
          - hal_st # required for ST sensors (unrelated to STM32 MCUs)
          - hal_wurthelektronik
          - liblc3
          - libmetal
          - littlefs
          - loramac-node
          - lvgl
          - lz4
          - mipi-sys-t
          - nanopb
          - net-tools
          - nrf_hw_models
          - open-amp
          - picolibc
          - psa-arch-tests
          - segger
          - tinycbor
          - tinycrypt
          - tf-m-tests
          - uoscore-uedhoc
          - zcbor
          - zscilib

  self:
    path: am_zephyr
```
